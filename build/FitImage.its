## build/FitImage.its
```
/*
 * U-Boot uImage source file for "smart210"
 */

/dts-v1/;

/ {
    description = "U-Boot uImage source file for smart210";
    #address-cells = <1>;

    images {
        kernel@smart210 {
            description = "Unify(TODO) Linux kernel for smart210";
            data = /incbin/("../linux/arch/arm/boot/zImage");
            type = "kernel";
            arch = "arm";
            os = "linux";
            compression = "none";
            load = <0x20008000>;
            entry = <0x20008000>;
        };
        fdt@smart210 {
            description = "Flattened Device Tree blob for smart210";
            data = /incbin/("../linux/arch/arm/boot/dts/s5pv210-smdkv210.dtb");
            type = "flat_dt";
            arch = "arm";
            compression = "none";
        };
    };

    configurations {
        default = "conf@smart210";
        conf@smart210 {
            description = "Boot Linux kernel with FDT blob";
            kernel = "kernel@smart210";
            fdt = "fdt@smart210";
        };
    };
};
```
